## Kconfig
```kconfig
#
# For a description of the syntax of this configuration file,
# see Documentation/kbuild/kconfig-language.txt.
#
mainmenu "Linux/$ARCH $KERNELVERSION Kernel Configuration"

config BRICKED_HOTPLUG
	bool "Enable kernel based mpdecision"
	depends on MSM_RUN_QUEUE_STATS
	default y
	help
	  This enables kernel based multi core control.
	  (up/down hotplug based on load)

config SRCARCH
	string
	option env="SRCARCH"

source "arch/$SRCARCH/Kconfig"
```

## arch/arm/kernel/Kconfig
```kconfig
config STATE_NOTIFIER
        bool "State Notifier"

config STATE_HELPER
        bool "State Helper"
	depends on STATE_NOTIFIER

config FAST_HOTPLUG
	bool "Enable fast hotplug"
	default n
	help
	  Kernel based core control.
```
